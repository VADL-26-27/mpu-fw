## CMakeLists.txt
```
cmake_minimum_required(VERSION 3.22.0)

# Locate MCUXpresso SDK.
get_filename_component(
    SdkRootDirPath
    "${CMAKE_CURRENT_LIST_DIR}/../../mcuxsdk"
    ABSOLUTE
)

include(${SdkRootDirPath}/cmake/extension/mcux.cmake)

project(mpu_m7
    LANGUAGES C CXX ASM
    PROJECT_BOARD_PORT_PATH ${board_root}/${board}/demo_apps/hello_world
)

include(${SdkRootDirPath}/CMakeLists.txt)

# Collect application and board source files.
file(GLOB_RECURSE APP_SOURCES CONFIGURE_DEPENDS
    RELATIVE ${CMAKE_CURRENT_SOURCE_DIR}
    "${CMAKE_CURRENT_SOURCE_DIR}/src/*.c"
    "${CMAKE_CURRENT_SOURCE_DIR}/board/*.c"
)

mcux_add_source(
    BASE_PATH ${CMAKE_CURRENT_SOURCE_DIR}
    SOURCES ${APP_SOURCES}
)

mcux_add_include(
    BASE_PATH ${CMAKE_CURRENT_SOURCE_DIR}
    INCLUDES
        include
        board
        freertos
)

# M7 resource table.
mcux_add_source(
    BASE_PATH ${SdkRootDirPath}
    SOURCES middleware/multicore/remoteproc/empty_rsc_table.c
)

# Board-wide binary conversion settings.
include(
    ${SdkRootDirPath}/examples/_boards/${board}/project_common.cmake
    OPTIONAL
)

mcux_convert_binary(
    BINARY ${APPLICATION_BINARY_DIR}/${MCUX_SDK_PROJECT_NAME}.bin
)
```

## prj.conf
```kconfig
CONFIG_MCUX_HW_DEVICE_PART_MIMX8ML8DVNLZ=y

# Keep SDK board support
CONFIG_MCUX_PRJSEG_module.board.boardfile=y
CONFIG_MCUX_PRJSEG_module.board.clock=y
CONFIG_MCUX_PRJSEG_module.board.suite=y

# Use custom pin mux
CONFIG_MCUX_PRJSEG_module.board.pinmux_customize_folder=y

# Use custom hardware initialization
CONFIG_MCUX_PRJSEG_project.hw_app_customize_folder=y

# ipwm
CONFIG_MCUX_COMPONENT_driver.ipwm=y

# FreeRTOS
CONFIG_MCUX_COMPONENT_middleware.freertos-kernel=y
CONFIG_MCUX_COMPONENT_middleware.freertos-kernel.heap_4=y

# ecspi
CONFIG_MCUX_COMPONENT_driver.ecspi=y

# igpio
CONFIG_MCUX_COMPONENT_driver.igpio=y
```

## src/main.c
```c
#include "fsl_device_registers.h"
#include "fsl_debug_console.h"
#include "board.h"
#include "hardware_init.h"
#include "FreeRTOS.h"
#include "task.h"
#include "tasks.h"
#include "fsl_ecspi.h"
#include <stdint.h>
#include "lsm9ds1.h"
#include "fsl_gpio.h"
#include "imu.h"
#include "control/attitude_estimator.h"

static void PrintSignedScaled(float value)
{
    int32_t scaled = (int32_t)(value * 1000.0f);

    if (scaled < 0)
    {
        PRINTF("-%u", (unsigned int)(-scaled));
    }
    else
    {
        PRINTF("%u", (unsigned int)scaled);
    }
}

int main(void)
{

    BOARD_InitHardware();

    PRINTF("MCUX SDK version: %s\r\n", MCUXSDK_VERSION_FULL_STR);

    PRINTF("hello world.\r\n");

    uint8_t agId = 0;
    uint8_t magId = 0;

    status_t agStatus = LSM9DS1_ReadData(LSM9DS1_AG, 0x0FU, &agId);
    status_t magStatus = LSM9DS1_ReadData(LSM9DS1_MAG, 0x0FU, &magId);

    PRINTF("AG WHO_AM_I: 0x%02X (status %d)\r\n", agId, agStatus);
    PRINTF("MAG WHO_AM_I: 0x%02X (status %d)\r\n", magId, magStatus);

    status_t status = IMU_Init();

    if (status != kStatus_Success)
    {
        PRINTF("IMU initialization failed: %u\r\n",
            (unsigned int)status);

        while (1);
    }

    PRINTF("IMU initialized successfully\r\n");

    imu_sample_t sample;

    status = IMU_ReadSample(&sample);

    if (status == kStatus_Success)
    {
        // Print scaled integer values to avoid SDK float
        // and signed-formatting limitations.

        PRINTF("Accel X magnitude (mm/s^2): %u\r\n",
            (unsigned int)(
                sample.accel.x < 0.0f
                ? -sample.accel.x * 1000.0f
                : sample.accel.x * 1000.0f));

        PRINTF("Gyro X magnitude (mrad/s): %u\r\n",
            (unsigned int)(
                sample.gyro.x < 0.0f
                ? -sample.gyro.x * 1000.0f
                : sample.gyro.x * 1000.0f));

        PRINTF("Mag X magnitude (uT): %u\r\n",
            (unsigned int)(
                sample.mag.x < 0.0f
                ? -sample.mag.x
                : sample.mag.x));
    }
    else
    {
        PRINTF("IMU read failed: %u\r\n",
            (unsigned int)status);
    }

    // PRINTF("Starting FreeRTOS...");

    // if (Tasks_Init() != pdPASS)
    // {
    //     PRINTF("Task initialization failed\r\n");

    //     while (1);
    // }

    // vTaskStartScheduler();

        attitude_estimator_t estimator;
    AttitudeEstimator_Init(&estimator);

    uint32_t count = 0;

    PRINTF("Starting attitude estimator superloop\r\n");

    while (1)
    {
        imu_sample_t raw;

        status_t readStatus = IMU_ReadSample(&raw);

        if (readStatus == kStatus_Success)
        {
            // Convert hardware sample to estimator input
            attitude_sample_t attitudeSample = {
                .accel = {
                    raw.accel.x,
                    raw.accel.y,
                    raw.accel.z
                },
                .gyro = {
                    raw.gyro.x,
                    raw.gyro.y,
                    raw.gyro.z
                },
                .mag = {
                    raw.mag.x,
                    raw.mag.y,
                    raw.mag.z
                }
            };

            quaternion_t q = AttitudeEstimator_Update(
                &estimator,
                &attitudeSample,
                0.01f
            );

            // Print approximately every 20 updates
            if (++count >= 20)
            {
                count = 0;

                PRINTF("Q: ");

                PrintSignedScaled(q.w);
                PRINTF(" ");

                PrintSignedScaled(q.x);
                PRINTF(" ");

                PrintSignedScaled(q.y);
                PRINTF(" ");

                PrintSignedScaled(q.z);
                PRINTF("\r\n");
            }
        }

        // Approximate 100 Hz sampling
        SDK_DelayAtLeastUs(10000U, SystemCoreClock);
    }
}
```

## include/bno085.h
```c
#ifndef BNO085_H
#define BNO085_H

#include <stdbool.h>
#include <stdint.h>

#include "fsl_common.h"
#include "control/quaternion.h"
#include "control/vector3.h"

typedef struct
{
    quaternion_t orientation;
    vector3_t angular_velocity;

    uint8_t orientation_accuracy;
    uint8_t gyro_accuracy;

    bool orientation_valid;
    bool gyro_valid;

    uint32_t orientation_count;
    uint32_t gyro_count;

} bno085_sample_t;

status_t BNO085_Init(void);
status_t BNO085_Process(void);
status_t BNO085_Read(bno085_sample_t *sample);

bool BNO085_InterruptActive(void);
bool BNO085_ReadNewSample(bno085_sample_t *sample);

status_t BNO085_SetReportIntervals(
    uint32_t rotation_us,
    uint32_t gyro_us
);

#endif
```

## include/hardware_init.h
```c
#ifndef _APP_H_
#define _APP_H_

void BOARD_InitPwm(void);
void BOARD_InitSpi(void);
void BOARD_InitHardware(void);

#endif // _APP_H_
```

## include/imu.h
```c
#ifndef IMU_H
#define IMU_H

#include <stdint.h>
#include "fsl_common.h"

typedef struct
{
    float x;
    float y;
    float z;
} imu_vector3_t;

typedef struct
{
    imu_vector3_t accel; // m/s^2
    imu_vector3_t gyro; // rad/s
    imu_vector3_t mag; // uT
} imu_sample_t;

status_t IMU_Init(void);

status_t IMU_ReadAccel(imu_vector3_t *accel);
status_t IMU_ReadGyro(imu_vector3_t *gyro);
status_t IMU_ReadMag(imu_vector3_t *mag);

status_t IMU_ReadSample(imu_sample_t *sample);

#endif // IMU_H
```

## include/lsm9ds1.h
```c
#ifndef LSM9DS1_H
#define LSM9DS1_H



#include <stdint.h>
#include "fsl_common.h"

typedef enum {
    LSM9DS1_AG,
    LSM9DS1_MAG
} lsm9ds1_device_t;

status_t LSM9DS1_WriteData(lsm9ds1_device_t device, uint8_t reg, uint8_t data);
status_t LSM9DS1_ReadData(lsm9ds1_device_t device, uint8_t reg, uint8_t *data);
status_t LSM9DS1_Init(void);
status_t LSM9DS1_ReadRegisters(
    lsm9ds1_device_t device,
    uint8_t startReg,
    uint8_t *buffer,
    size_t length
);

#endif // LSM9DS1_H
```

## include/tasks.h
```c
#ifndef TASKS_H
#define TASKS_H

#include "FreeRTOS.h"
#include "task.h"

BaseType_t Tasks_Init(void);

#endif // TASKS_H
```

## src/bno085.c
```c
#include "bno085.h"

#include <string.h>

#include "fsl_ecspi.h"
#include "fsl_gpio.h"
#include "fsl_debug_console.h"

// hardware configuration
#define BNO085_SPI       ECSPI2

#define BNO085_CS_GPIO   GPIO5
#define BNO085_CS_PIN    13U

#define BNO085_INT_GPIO  GPIO3
#define BNO085_INT_PIN   6U

#define BNO085_WAKE_GPIO GPIO3
#define BNO085_WAKE_PIN  14U

// define BNO085_WAKE_GPIO and BNO085_WAKE_PIN in board configuration
#if defined(BNO085_WAKE_GPIO) && defined(BNO085_WAKE_PIN)
#define BNO085_HAS_WAKE 1
#else
#define BNO085_HAS_WAKE 0
#endif

// SHTP configuration
#define BNO085_SHTP_HEADER_SIZE    4U
#define BNO085_MAX_PAYLOAD         512U

#define BNO085_CHANNEL_CONTROL     2U
#define BNO085_CHANNEL_REPORTS     3U
#define BNO085_CHANNEL_WAKE        4U

#define BNO085_REPORT_SET_FEATURE  0xFDU
#define BNO085_REPORT_ROTATION     0x05U
#define BNO085_REPORT_GYRO         0x02U
#define BNO085_REPORT_TIMEBASE     0xFBU

#define BNO085_DEFAULT_PERIOD_US   10000U
#define BNO085_READY_SPINS         2000000U

// driver state
static uint8_t s_txSequence[6];
static uint8_t s_payload[BNO085_MAX_PAYLOAD];

static bno085_sample_t s_sample;
static uint32_t s_lastReadCount;
static bool s_initialized;

static uint16_t BNO085_U16(const uint8_t *p)
{
    return (uint16_t)(
        (uint16_t)p[0] |
        ((uint16_t)p[1] << 8)
    );
}

static int16_t BNO085_S16(const uint8_t *p)
{
    return (int16_t)BNO085_U16(p);
}

static void BNO085_PutU32(uint8_t *p, uint32_t value)
{
    p[0] = (uint8_t)value;
    p[1] = (uint8_t)(value >> 8);
    p[2] = (uint8_t)(value >> 16);
    p[3] = (uint8_t)(value >> 24);
}

bool BNO085_InterruptActive(void)
{
    return GPIO_PinRead(
        BNO085_INT_GPIO,
        BNO085_INT_PIN
    ) == 0U;
}

static void BNO085_ChipSelect(bool active)
{
    GPIO_PinWrite(
        BNO085_CS_GPIO,
        BNO085_CS_PIN,
        active ? 0U : 1U
    );
}

// SPI transfer
static status_t BNO085_TransferByte(
    uint8_t tx,
    uint8_t *rx
)
{
    uint32_t txWord = tx;
    uint32_t rxWord = 0U;

    ecspi_transfer_t transfer = {
        .txData = &txWord,
        .rxData = &rxWord,
        .dataSize = 1U,
        .channel = kECSPI_Channel0
    };

    status_t status = ECSPI_MasterTransferBlocking(
        BNO085_SPI,
        &transfer
    );

    if ((status == kStatus_Success) && (rx != NULL))
    {
        *rx = (uint8_t)rxWord;
    }

    return status;
}

static status_t BNO085_Transfer(
    const uint8_t *tx,
    uint8_t *rx,
    uint16_t count
)
{
    for (uint16_t i = 0U; i < count; ++i)
    {
        uint8_t incoming = 0U;

        status_t status = BNO085_TransferByte(
            tx != NULL ? tx[i] : 0U,
            &incoming
        );

        if (status != kStatus_Success)
        {
            return status;
        }

        if (rx != NULL)
        {
            rx[i] = incoming;
        }
    }

    return kStatus_Success;
}

// wake handshake
static status_t BNO085_WaitReady(void)
{
#if !BNO085_HAS_WAKE

    PRINTF("BNO085 WAKE timeout\r\n");
    return kStatus_Fail;

#else

    GPIO_PinWrite(
        BNO085_WAKE_GPIO,
        BNO085_WAKE_PIN,
        0U
    );

    for (uint32_t i = 0U; i < BNO085_READY_SPINS; ++i)
    {
        if (BNO085_InterruptActive())
        {
            return kStatus_Success;
        }
    }

    GPIO_PinWrite(
        BNO085_WAKE_GPIO,
        BNO085_WAKE_PIN,
        1U
    );

    return kStatus_Timeout;

#endif
}

static void BNO085_EndWake(void)
{
#if BNO085_HAS_WAKE

    GPIO_PinWrite(
        BNO085_WAKE_GPIO,
        BNO085_WAKE_PIN,
        1U
    );

#endif
}


static status_t BNO085_SendPacket(
    uint8_t channel,
    const uint8_t *payload,
    uint16_t payloadLength
)
{
    if ((payload == NULL) ||
        (channel >= sizeof(s_txSequence)) ||
        (payloadLength > BNO085_MAX_PAYLOAD))
    {
        return kStatus_InvalidArgument;
    }

    PRINTF("BNO085: waiting for WAKE handshake\r\n");

    status_t status = BNO085_WaitReady();

    PRINTF("BNO085: handshake status=%d INT=%d\r\n",
           (int)status,
           (int)BNO085_InterruptActive());

    if (status != kStatus_Success)
    {
        return status;
    }

    uint16_t length =
        payloadLength + BNO085_SHTP_HEADER_SIZE;

    uint8_t header[4] = {
        (uint8_t)length,
        (uint8_t)(length >> 8),
        channel,
        s_txSequence[channel]++
    };

    PRINTF("BNO085: sending SHTP header\r\n");

    BNO085_ChipSelect(true);

    status = BNO085_Transfer(header, NULL, sizeof(header));

    PRINTF("BNO085: header status=%d\r\n", (int)status);

    if (status == kStatus_Success)
    {
        PRINTF("BNO085: sending payload\r\n");

        status = BNO085_Transfer(
            payload,
            NULL,
            payloadLength
        );

        PRINTF("BNO085: payload status=%d\r\n", (int)status);
    }

    BNO085_ChipSelect(false);
    BNO085_EndWake();

    return status;
}


// sensor report parsing
static void BNO085_ParseReports(
    const uint8_t *p,
    uint16_t size
)
{
    uint16_t offset = 0U;

    while (offset < size)
    {
        uint8_t id = p[offset];

        if (id == BNO085_REPORT_TIMEBASE)
        {
            if ((size - offset) < 5U)
            {
                break;
            }

            offset += 5U;
        }
        else if (id == BNO085_REPORT_ROTATION)
        {
            if ((size - offset) < 14U)
            {
                break;
            }

            const uint8_t *r = &p[offset];

            // Q14 quaternion
            s_sample.orientation.x =
                (float)BNO085_S16(&r[4]) / 16384.0f;

            s_sample.orientation.y =
                (float)BNO085_S16(&r[6]) / 16384.0f;

            s_sample.orientation.z =
                (float)BNO085_S16(&r[8]) / 16384.0f;

            s_sample.orientation.w =
                (float)BNO085_S16(&r[10]) / 16384.0f;

            s_sample.orientation_accuracy =
                r[2] & 0x03U;

            s_sample.orientation_valid = true;
            ++s_sample.orientation_count;

            offset += 14U;
        }
        else if (id == BNO085_REPORT_GYRO)
        {
            if ((size - offset) < 10U)
            {
                break;
            }

            const uint8_t *r = &p[offset];

            // Q9 angular velocity in rad/s
            s_sample.angular_velocity.x =
                (float)BNO085_S16(&r[4]) / 512.0f;

            s_sample.angular_velocity.y =
                (float)BNO085_S16(&r[6]) / 512.0f;

            s_sample.angular_velocity.z =
                (float)BNO085_S16(&r[8]) / 512.0f;

            s_sample.gyro_accuracy =
                r[2] & 0x03U;

            s_sample.gyro_valid = true;
            ++s_sample.gyro_count;

            offset += 10U;
        }
        else
        {
            break;
        }
    }
}

// SHTP receive
status_t BNO085_Process(void)
{
    if (!BNO085_InterruptActive())
    {
        return kStatus_Fail;
    }

    uint8_t header[4];

    BNO085_ChipSelect(true);

    status_t status = BNO085_Transfer(
        NULL,
        header,
        sizeof(header)
    );

    if (status != kStatus_Success)
    {
        BNO085_ChipSelect(false);
        return status;
    }

    uint16_t rawLength = BNO085_U16(header);
    bool continuation = (rawLength & 0x8000U) != 0U;
    uint16_t length = rawLength & 0x7FFFU;

    if (length < BNO085_SHTP_HEADER_SIZE)
    {
        BNO085_ChipSelect(false);
        return kStatus_Fail;
    }

    uint16_t payloadLength =
        length - BNO085_SHTP_HEADER_SIZE;

    if (payloadLength > BNO085_MAX_PAYLOAD)
    {
        for (uint16_t i = 0U; i < payloadLength; ++i)
        {
            status = BNO085_TransferByte(0U, NULL);

            if (status != kStatus_Success)
            {
                break;
            }
        }

        BNO085_ChipSelect(false);
        return kStatus_Fail;
    }

    status = BNO085_Transfer(
        NULL,
        s_payload,
        payloadLength
    );

    BNO085_ChipSelect(false);

    if (status != kStatus_Success)
    {
        return status;
    }

    if (continuation)
    {
        return kStatus_Fail;
    }

    if ((header[2] == BNO085_CHANNEL_REPORTS) ||
        (header[2] == BNO085_CHANNEL_WAKE))
    {
        BNO085_ParseReports(
            s_payload,
            payloadLength
        );
    }

    return kStatus_Success;
}

// sensor configuration
static status_t BNO085_SetFeature(
    uint8_t reportId,
    uint32_t intervalUs
)
{
    uint8_t payload[17] = {0};

    payload[0] = BNO085_REPORT_SET_FEATURE;
    payload[1] = reportId;

    BNO085_PutU32(
        &payload[5],
        intervalUs
    );

    return BNO085_SendPacket(
        BNO085_CHANNEL_CONTROL,
        payload,
        sizeof(payload)
    );
}

status_t BNO085_SetReportIntervals(
    uint32_t rotation_us,
    uint32_t gyro_us
)
{
    status_t status = BNO085_SetFeature(
        BNO085_REPORT_ROTATION,
        rotation_us
    );

    if (status != kStatus_Success)
    {
        return status;
    }

    for (uint32_t i = 0U;
         i < 16U && BNO085_InterruptActive();
         ++i)
    {
        status = BNO085_Process();

        if (status != kStatus_Success)
        {
            return status;
        }
    }

    return BNO085_SetFeature(
        BNO085_REPORT_GYRO,
        gyro_us
    );
}

// initialization

status_t BNO085_Init(void)
{
    memset(s_txSequence, 0, sizeof(s_txSequence));
    memset(&s_sample, 0, sizeof(s_sample));

    s_lastReadCount = 0U;
    s_initialized = false;

    BNO085_ChipSelect(false);

#if !BNO085_HAS_WAKE

    PRINTF("BNO085: WAKE GPIO undefined\r\n");
    return kStatus_Fail;

#else

    GPIO_PinWrite(
        BNO085_WAKE_GPIO,
        BNO085_WAKE_PIN,
        1U
    );

    PRINTF("BNO085: starting initialization\r\n");

    PRINTF("BNO085: WAKE=%d INT=%d\r\n",
        (int)GPIO_PinRead(BNO085_WAKE_GPIO, BNO085_WAKE_PIN),
        (int)GPIO_PinRead(BNO085_INT_GPIO, BNO085_INT_PIN));

    // process startup packets
    for (uint32_t i = 0U;
        i < 32U && BNO085_InterruptActive();
        ++i)
    {
        PRINTF("BNO085: reading startup packet %d\r\n", (int)i);

        status_t status = BNO085_Process();

        PRINTF("BNO085: startup packet status=%d\r\n", (int)status);

        if (status != kStatus_Success)
        {
            return status;
        }
    }

    PRINTF("BNO085: configuring rotation vector\r\n");

    status_t status = BNO085_SetFeature(
        BNO085_REPORT_ROTATION,
        BNO085_DEFAULT_PERIOD_US
    );

    PRINTF("BNO085: rotation config status=%d\r\n", (int)status);

    if (status != kStatus_Success)
    {
        return status;
    }

    // process pending packets
    for (uint32_t i = 0U;
        i < 16U && BNO085_InterruptActive();
        ++i)
    {
        PRINTF("BNO085: processing packet %d\r\n", (int)i);

        status = BNO085_Process();

        PRINTF("BNO085: packet status=%d\r\n", (int)status);

        if (status != kStatus_Success)
        {
            return status;
        }
    }

    PRINTF("BNO085: configuring gyroscope\r\n");

    status = BNO085_SetFeature(
        BNO085_REPORT_GYRO,
        BNO085_DEFAULT_PERIOD_US
    );

    PRINTF("BNO085: gyro config status=%d\r\n", (int)status);

    if (status != kStatus_Success)
    {
        return status;
    }

    s_initialized = true;

    PRINTF("BNO085: initialization complete\r\n");

    return kStatus_Success;

#endif
}


// sensor data access
status_t BNO085_Read(bno085_sample_t *sample)
{
    if ((sample == NULL) || !s_initialized)
    {
        return kStatus_Fail;
    }

    *sample = s_sample;

    return kStatus_Success;
}

bool BNO085_ReadNewSample(bno085_sample_t *sample)
{
    if ((sample == NULL) ||
        !s_initialized ||
        !s_sample.orientation_valid ||
        (s_sample.orientation_count == s_lastReadCount))
    {
        return false;
    }

    *sample = s_sample;
    s_lastReadCount = s_sample.orientation_count;

    return true;
}
```

## src/imu.c
```c
#include "imu.h"
#include "lsm9ds1.h"

#define IMU_ACCEL_OUT_REG   0x28U
#define IMU_GYRO_OUT_REG    0x18U
#define IMU_MAG_OUT_REG     0x28U

// Sensitivities for current LSM9DS1 configuration
#define IMU_ACCEL_SCALE     (0.000061f * 9.80665f) // m/s^2 per LSB
#define IMU_GYRO_SCALE      (0.00875f * 0.01745329252f) // rad/s per LSB
#define IMU_MAG_SCALE       (0.014f) // uT per LSB

static int16_t IMU_DecodeAxis(const uint8_t *data)
{
    uint16_t raw = (uint16_t)data[0] |
                   ((uint16_t)data[1] << 8);

    return (int16_t)raw;
}

static void IMU_ConvertAxes(
    const uint8_t *raw,
    float scale,
    imu_vector3_t *vector)
{
    vector->x = (float)IMU_DecodeAxis(&raw[0]) * scale;
    vector->y = (float)IMU_DecodeAxis(&raw[2]) * scale;
    vector->z = (float)IMU_DecodeAxis(&raw[4]) * scale;
}

status_t IMU_Init(void)
{
    return LSM9DS1_Init();
}

status_t IMU_ReadAccel(imu_vector3_t *accel)
{
    if (accel == NULL)
        return kStatus_InvalidArgument;

    uint8_t raw[6];

    status_t status = LSM9DS1_ReadRegisters(
        LSM9DS1_AG,
        IMU_ACCEL_OUT_REG,
        raw,
        sizeof(raw)
    );

    if (status != kStatus_Success)
        return status;

    IMU_ConvertAxes(raw, IMU_ACCEL_SCALE, accel);

    return kStatus_Success;
}

status_t IMU_ReadGyro(imu_vector3_t *gyro)
{
    if (gyro == NULL)
        return kStatus_InvalidArgument;

    uint8_t raw[6];

    status_t status = LSM9DS1_ReadRegisters(
        LSM9DS1_AG,
        IMU_GYRO_OUT_REG,
        raw,
        sizeof(raw)
    );

    if (status != kStatus_Success)
        return status;

    IMU_ConvertAxes(raw, IMU_GYRO_SCALE, gyro);

    return kStatus_Success;
}

status_t IMU_ReadMag(imu_vector3_t *mag)
{
    if (mag == NULL)
        return kStatus_InvalidArgument;

    uint8_t raw[6];

    status_t status = LSM9DS1_ReadRegisters(
        LSM9DS1_MAG,
        IMU_MAG_OUT_REG,
        raw,
        sizeof(raw)
    );

    if (status != kStatus_Success)
        return status;

    IMU_ConvertAxes(raw, IMU_MAG_SCALE, mag);

    return kStatus_Success;
}

status_t IMU_ReadSample(imu_sample_t *sample)
{
    if (sample == NULL)
        return kStatus_InvalidArgument;

    status_t status;

    status = IMU_ReadAccel(&sample->accel);
    if (status != kStatus_Success)
        return status;

    status = IMU_ReadGyro(&sample->gyro);
    if (status != kStatus_Success)
        return status;

    status = IMU_ReadMag(&sample->mag);
    if (status != kStatus_Success)
        return status;

    return kStatus_Success;
}
```

## src/lsm9ds1.c
```c
#include "lsm9ds1.h"
#include "fsl_ecspi.h"


#include "lsm9ds1.h"
#include "fsl_ecspi.h"
#include "fsl_gpio.h"

#define LSM9DS1_WHO_AM_I       0x0FU

#define LSM9DS1_CTRL_REG1_G    0x10U
#define LSM9DS1_CTRL_REG6_XL   0x20U
#define LSM9DS1_CTRL_REG8      0x22U

#define LSM9DS1_CTRL_REG1_M    0x20U
#define LSM9DS1_CTRL_REG2_M    0x21U
#define LSM9DS1_CTRL_REG3_M    0x22U
#define LSM9DS1_CTRL_REG4_M    0x23U
#define LSM9DS1_CTRL_REG5_M    0x24U

static void LSM9DS1_SetChipSelect(lsm9ds1_device_t device,
                                  bool active)
{
    uint8_t level = active ? 0U : 1U;

    switch (device)
    {
        case LSM9DS1_AG:
            GPIO_PinWrite(GPIO5, 13U, level);
            break;

        case LSM9DS1_MAG:
            GPIO_PinWrite(GPIO3, 6U, level);
            break;

        default:
            break;
    }
}

status_t LSM9DS1_WriteData(lsm9ds1_device_t device,
                           uint8_t reg,
                           uint8_t data)
{
    uint8_t command;

    switch (device)
    {
        case LSM9DS1_AG:
            command = reg & 0x7FU;
            break;

        case LSM9DS1_MAG:
            command = reg & 0x3FU;
            break;

        default:
            return kStatus_InvalidArgument;
    }

    uint32_t txData = ((uint32_t)command << 8) | data;

    ecspi_transfer_t transfer = {
        .txData = &txData,
        .rxData = NULL,
        .dataSize = 1U,
        .channel = kECSPI_Channel0
    };

    LSM9DS1_SetChipSelect(device, true);

    status_t status = ECSPI_MasterTransferBlocking(ECSPI2, &transfer);

    LSM9DS1_SetChipSelect(device, false);

    return status;
}

status_t LSM9DS1_ReadData(lsm9ds1_device_t device,
                          uint8_t reg,
                          uint8_t *data)
{
    if (data == NULL)
    {
        return kStatus_InvalidArgument;
    }

    uint8_t command;

    switch (device)
    {
        case LSM9DS1_AG:
            command = (reg & 0x7FU) | 0x80U;
            break;

        case LSM9DS1_MAG:
            command = (reg & 0x3FU) | 0x80U;
            break;

        default:
            return kStatus_InvalidArgument;
    }

    uint32_t txData = (uint32_t)command << 8;
    uint32_t rxData = 0U;

    ecspi_transfer_t transfer = {
        .txData = &txData,
        .rxData = &rxData,
        .dataSize = 1U,
        .channel = kECSPI_Channel0
    };

    LSM9DS1_SetChipSelect(device, true);

    status_t status = ECSPI_MasterTransferBlocking(ECSPI2, &transfer);

    LSM9DS1_SetChipSelect(device, false);

    if (status != kStatus_Success)
    {
        return status;
    }

    *data = (uint8_t)(rxData & 0xFFU);

    return kStatus_Success;
}

status_t LSM9DS1_Init(void)
{
    status_t status;
    uint8_t agId;
    uint8_t magId;

    // Verify device identities
    status = LSM9DS1_ReadData(LSM9DS1_AG, LSM9DS1_WHO_AM_I, &agId);
    if (status != kStatus_Success)
        return status;

    if (agId != 0x68U)
        return kStatus_Fail;

    status = LSM9DS1_ReadData(LSM9DS1_MAG, LSM9DS1_WHO_AM_I, &magId);
    if (status != kStatus_Success)
        return status;

    if (magId != 0x3DU)
        return kStatus_Fail;

    // Accelerometer / gyroscope configuration
    status = LSM9DS1_WriteData(LSM9DS1_AG, LSM9DS1_CTRL_REG1_G, 0x60U);
    if (status != kStatus_Success)
        return status;

    status = LSM9DS1_WriteData(LSM9DS1_AG, LSM9DS1_CTRL_REG6_XL, 0x60U);
    if (status != kStatus_Success)
        return status;

    status = LSM9DS1_WriteData(LSM9DS1_AG, LSM9DS1_CTRL_REG8, 0x44U);
    if (status != kStatus_Success)
        return status;

    // Magnetometer configuration
    status = LSM9DS1_WriteData(LSM9DS1_MAG, LSM9DS1_CTRL_REG1_M, 0x70U);
    if (status != kStatus_Success)
        return status;

    status = LSM9DS1_WriteData(LSM9DS1_MAG, LSM9DS1_CTRL_REG2_M, 0x00U);
    if (status != kStatus_Success)
        return status;

    status = LSM9DS1_WriteData(LSM9DS1_MAG, LSM9DS1_CTRL_REG3_M, 0x00U);
    if (status != kStatus_Success)
        return status;

    status = LSM9DS1_WriteData(LSM9DS1_MAG, LSM9DS1_CTRL_REG4_M, 0x0CU);
    if (status != kStatus_Success)
        return status;

    status = LSM9DS1_WriteData(LSM9DS1_MAG, LSM9DS1_CTRL_REG5_M, 0x40U);
    if (status != kStatus_Success)
        return status;

    return kStatus_Success;
}

status_t LSM9DS1_ReadRegisters(
    lsm9ds1_device_t device,
    uint8_t startReg,
    uint8_t *buffer,
    size_t length)
{
    if (buffer == NULL || length == 0U || length > 6U)
        return kStatus_InvalidArgument;

    uint8_t command;

    switch (device)
    {
        case LSM9DS1_AG:
            command = (startReg & 0x7FU) | 0x80U;
            break;

        case LSM9DS1_MAG:
            command = (startReg & 0x3FU) | 0xC0U;
            break;

        default:
            return kStatus_InvalidArgument;
    }

    // Command + up to six response bytes, packed MSB-first.
    uint32_t txData[2] = {0U, 0U};
    uint32_t rxData[2] = {0U, 0U};

    const size_t totalBytes = length + 1U;
    const size_t wordCount = (totalBytes + 3U) / 4U;

    // ECSPI shifts the most significant bits of the burst first.
    // The first FIFO word contains the earliest transmitted bits.
    size_t firstWordBytes = totalBytes - (wordCount - 1U) * 4U;
    txData[0] = (uint32_t)command << ((firstWordBytes - 1U) * 8U);

    uint32_t originalConreg = ECSPI2->CONREG;

    ECSPI2->CONREG =
        (originalConreg & ~ECSPI_CONREG_BURST_LENGTH_MASK) |
        ECSPI_CONREG_BURST_LENGTH(totalBytes * 8U - 1U);

    ecspi_transfer_t transfer = {
        .txData = txData,
        .rxData = rxData,
        .dataSize = wordCount,
        .channel = kECSPI_Channel0
    };

    LSM9DS1_SetChipSelect(device, true);

    status_t status = ECSPI_MasterTransferBlocking(
        ECSPI2, &transfer);

    LSM9DS1_SetChipSelect(device, false);

    ECSPI2->CONREG = originalConreg;

    if (status != kStatus_Success)
        return status;

    // Extract response bytes, excluding the command phase.
    for (size_t i = 0; i < length; i++)
    {
        size_t byteIndex = i + 1U;
        size_t wordIndex;
        size_t bytePosition;

        if (byteIndex < firstWordBytes)
        {
            wordIndex = 0U;
            bytePosition = firstWordBytes - 1U - byteIndex;
        }
        else
        {
            wordIndex = 1U;
            bytePosition = 3U - (byteIndex - firstWordBytes);
        }

        buffer[i] = (uint8_t)(
            (rxData[wordIndex] >> (bytePosition * 8U)) & 0xFFU);
    }

    return kStatus_Success;
}
```

## src/tasks.c
```c
#include "tasks.h"
#include "fsl_debug_console.h"

#define TEST_TASK_STACK_SIZE 256
#define TEST_TASK_PRIORITY   2

static void TestTask(void *pvParameters)
{
    (void)pvParameters;

    while (1)
    {
        PRINTF("FreeRTOS task running!\r\n");
        vTaskDelay(pdMS_TO_TICKS(1000));
    }
}

BaseType_t Tasks_Init(void)
{
    BaseType_t status;

    status = xTaskCreate(
        TestTask,
        "Test",
        TEST_TASK_STACK_SIZE,
        NULL,
        TEST_TASK_PRIORITY,
        NULL
    );

    return status;
}
```
